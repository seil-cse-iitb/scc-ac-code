#include <SPI.h>
#include <RF24.h>
#include <nRF24L01.h>
#include <IRremote.h>
#include <LowPower.h>

IRsend irsend;

const int khz = 38;

const int pinCE = 7;
const int pinCSN = 8;
RF24 radio(pinCE, pinCSN);

//const uint64_t rAddress = 0x00001E201BLL; // DO CHECK THE ADDRESS BEFORE PROGRAMMING IT
const uint64_t rAddress = 0x00001E5205LL;   // Address for 201

char ac_state = '\0';
bool serRead = false;
bool received = false;
int receivedCount = 0;

// Hitachi VRF - SEIL Lab
//unsigned int Signal_ON[] = {3488, 1584, 548, 1184, 520, 348, 520, 348, 544, 348, 520, 344, 524,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 320, 548};
//unsigned int Signal_OFF[] = {3488, 1608, 544, 1160, 524, 372, 544, 320, 548, 320, 520, 372, 520,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 320, 544};

// O-General Classroom
unsigned int Signal_ON[] = {3388, 1508, 496, 320, 524, 296, 520, 1112, 520, 296, 496, 1136, 524,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 296, 520};
unsigned int Signal_OFF[] = {3392, 1532, 520, 296, 496, 320, 524, 1112, 496, 320, 496, 1136, 520,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 1120, 512};

void radioListen()
{
  
  while (radio.available())
  {
    radio.read(&ac_state, sizeof(ac_state));
    received = true;
  }
}

void turn_on_ac()
{
  irsend.sendRaw(Signal_ON, sizeof(Signal_ON) / sizeof(Signal_ON[0]), khz);
  delay(100);
  Serial.println("Turning ON AC");
}

void turn_off_ac()
{
  irsend.sendRaw(Signal_OFF, sizeof(Signal_OFF) / sizeof(Signal_OFF[0]), khz);
  delay(100);
  Serial.println("Turning OFF AC");
}

void initRadio()
{
  radio.begin();
  //radio.setAutoAck(1);
  radio.setRetries(15, 15);
  radio.setDataRate(RF24_250KBPS);
  radio.setPALevel(RF24_PA_MIN);
  radio.setChannel(105);
  radio.openReadingPipe(1, rAddress);
  radio.startListening();
}

void setup() {
  // put your setup code here, to run once:
  Serial.begin(9600);
  Serial.println(F("____nRF_IR_Testing____"));
  Serial.println(F(""));

  initRadio();
}

void loop() {
  // put your main code here, to run repeatedly:
  while (Serial.available())
  {
    ac_state = Serial.read();
    serRead = true;
  }

  if (serRead || received)
  {
    radio.stopListening();
    if (ac_state == '1') turn_on_ac();
    else if (ac_state == '0') turn_off_ac();
    else Serial.println(F("Bad Data"));

    serRead = false;
    received = false;

    receivedCount++;

    radio.startListening();
  }

  if(receivedCount < 2) radioListen();
  else
  {
    //radio.powerDown();
    //LowPower.powerDown(SLEEP_8S, ADC_OFF, BOD_OFF);
    delay(6000);
    receivedCount = 0;
  }
            }
